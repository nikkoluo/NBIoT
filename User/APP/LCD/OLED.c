/******************** (C) COPYRIGHT 2017 陆超 **********************************
* File Name 		 :	GPIO_Port.c
* Author			 :	陆超
* CPU Type			 :	nRF51802
* IDE				 :	IAR 7.8
* Version			 :	V1.0
* Date				 :	04/11/2017
* Description		 :	OLED驱动程序
*						采用列行式，分辨率为128*64
*						存放格式如下.
*						[0]0 1 2 3 ... 127    	bit0
*												bit1
*												……
*												bit7
*						[1]0 1 2 3 ... 127	
*						[2]0 1 2 3 ... 127	
*						[3]0 1 2 3 ... 127	
*						[4]0 1 2 3 ... 127	
*						[5]0 1 2 3 ... 127	
*						[6]0 1 2 3 ... 127	
*						[7]0 1 2 3 ... 127
*******************************************************************************/
/* Includes ------------------------------------------------------------------*/
#include "OLED.h"
#include "nrf_delay.h"



/* Private variables ---------------------------------------------------------*/
static u8 OLED_Map[X_WIDTH][Y_WIDTH >> 3];								// 显存

static const u8 F6x8[] =
{
    0x00, 0x00, 0x00, 0x00, 0x00, 0x00 ,   // sp
    0x00, 0x00, 0x00, 0x2f, 0x00, 0x00 ,   // !
    0x00, 0x00, 0x07, 0x00, 0x07, 0x00 ,   // "
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    0x14, 0x14, 0x14, 0x14, 0x14, 0x14     // horiz lines
};																		// 6 * 8 Ascii																	

static const u8 F8X16[]=
{
	0x00,0x00,0x00,0x00,0x00,0x00,0x00,0x00,0x00,0x00,0x00,0x00,0x00,0x00,0x00,0x00,// 0
	0x00,0x00,0x00,0xF8,0x00,0x00,0x00,0x00,0x00,0x00,0x00,0x33,0x30,0x00,0x00,0x00,//!1
	0x00,0x10,0x0C,0x06,0x10,0x0C,0x06,0x00,0x00,0x00,0x00,0x00,0x00,0x00,0x00,0x00,//"2
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	0x00,0x06,0x01,0x01,0x02,0x02,0x04,0x04,0x00,0x00,0x00,0x00,0x00,0x00,0x00,0x00,//~94

};


/* Private functions ---------------------------------------------------------*/
void OLED_Port_Init(void);												// 端口初始化
void OLED_Write_Data(u8 ucData);										// OLED写数据
void OLED_Write_Cmd(u8 ucCmd);                                          // OLED写命令
void OLED_Set_Pos(u8 x, u8 y);											// 设置坐标
void OLED_Fill(u8 Data);												// 数据填充
void OLED_CLS(void);													// 清空数据
void OLED_Delay_ms(u16 ms);												// ms延时
void OLED_Init(void);													// OLED初始化   
void OLED_DrawPixel(u8 x, u8 y, u8 Value);								// 画点
void OLED_DrawPixel_Map(u8 x, u8 y, u8 Value);							// 修改显存点
void OLED_Draw_YPage(u8 x, u8 y, u8 *pData, u8 ucByte);					// 写Y轴
void OLED_String_6x8(u8 x, u8 y, u8 *pData, u8 ucLen);					// 写6*8字符



/*******************************************************************************
*                           陆超@2017-04-09
* Function Name  :  OLED_Port_Init
* Description    :  OLED端口初始化
* Input          :  None
* Output         :  None
* Return         :  1成功 0失败
*******************************************************************************/
void OLED_Port_Init(void)
{
    // 配置管脚为输出
    nrf_gpio_cfg_output(OLED_SDA_PIN);
	nrf_gpio_cfg_output(OLED_SCL_PIN);
	nrf_gpio_cfg_output(OLED_RST_PIN);
	nrf_gpio_cfg_output(OLED_DC_PIN);

       
}// End of void OLED_Port_Init(void)

/*******************************************************************************
*                           陆超@2017-04-10
* Function Name  :  OLED_Write_Data
* Description    :  OLED写数据
* Input          :  u8 ucData 要写入的数据
* Output         :  None
* Return         :  None
*******************************************************************************/
void OLED_Write_Data(u8 ucData)
{
	u8 i = 8;

	OLED_DC_SET();
	OLED_SCL_CLR();

	while(i--)
	{
		if(ucData & 0x80)
		{
			OLED_SDA_SET();
		}
		else
		{
			OLED_SDA_CLR();
		}

		OLED_SCL_SET(); 
		          
		OLED_SCL_CLR();    
		ucData <<= 1;    
	}
	
}// End of void OLED_Write_Data(u8 ucData)

/*******************************************************************************
*                           陆超@2017-04-10
* Function Name  :  OLED_Write_Cmd
* Description    :  OLED写命令
* Input          :  u8 ucCmd 要写入的命令
* Output         :  None
* Return         :  None
*******************************************************************************/
void OLED_Write_Cmd(u8 ucCmd)
{
	u8 i=8;


	OLED_DC_CLR();
	OLED_SCL_CLR();

	while(i--)
	{
		if(ucCmd & 0x80)
		{
			OLED_SDA_SET();
		}
		else
		{
			OLED_SDA_CLR();
		}

		OLED_SCL_SET();

		OLED_SCL_CLR();    
		ucCmd <<= 1;;   
	} 	
	
}// End of void OLED_Write_Cmd(u8 ucCmd)

/*******************************************************************************
*							陆超@2017-04-12
* Function Name  :	OLED_Set_Pos
* Description	 :	OLED设置位置
* Input 		 :	u8 x x坐标 0~128
*					u8 y y坐标 0~63 必须是8的倍数
* Output		 :	None
* Return		 :	None
*******************************************************************************/
void OLED_Set_Pos(u8 x, u8 y)
{ 
	// 设置地址y 0~7
	OLED_Write_Cmd(OLED_CMD_Y_ADDR + (y / 8));

	// 设置地址x低字节和高字节
	OLED_Write_Cmd(( x & 0x0F));
	OLED_Write_Cmd(((x & 0xF0) >> 4) | 0x10);
	
}// End of void OLED_Set_Pos(u8 x, u8 y) 

/*******************************************************************************
*							陆超@2017-04-13
* Function Name  :	OLED_Fill
* Description	 :	OLED数据填充
* Input 		 :	u8 Data	待填充数据
* Output		 :	None
* Return		 :	None
*******************************************************************************/
void OLED_Fill(u8 Data)
{
    u16 y = 0, x = 0;
	
	for (y = 0; y < Y_PAGE; y++)
	{
		OLED_Set_Pos(0, y << 3);
		for (x = 0; x < X_WIDTH; x++)
		{
			OLED_Map[x][y] = Data;
			OLED_Write_Data(OLED_Map[x][y]);
		}
	}


}// End of void OLED_Fill(u8 *pData)

/*******************************************************************************
*							陆超@2017-04-13
* Function Name  :	OLED_CLS
* Description	 :	OLED清空数据
* Input 		 :	None
* Output		 :	None
* Return		 :	None
*******************************************************************************/
void OLED_CLS(void)
{
    u16 y = 0, x = 0;
	
	for (y = 0; y < Y_PAGE; y++)
	{
		OLED_Set_Pos(0, y << 3);
		for (x = 0; x < X_WIDTH; x++)
		{
			OLED_Map[x][y] = 0;
			OLED_Write_Data(OLED_Map[x][y]);
		}
	}
	
}// End of void OLED_CLS(void)

/*******************************************************************************
*							陆超@2017-04-15
* Function Name  :	OLED_Delay_ms
* Description	 :	OLED ms延时
* Input 		 :	u16 ms 延时时间
* Output		 :	None
* Return		 :	None
*******************************************************************************/
void OLED_Delay_ms(u16 ms)
{                         
	nrf_delay_ms(ms);
	
}// End of void OLED_Delay_ms(u16 ms)

/*******************************************************************************
*							陆超@2017-04-15
* Function Name  :	OLED_Init
* Description	 :	OLED 初始化
* Input 		 :	None
* Output		 :	None
* Return		 :	None
*******************************************************************************/
void OLED_Init(void)        
{

	//预制SLK和SS为高电平
	OLED_SCL_SET();
		   	

	OLED_RST_CLR();
	OLED_Delay_ms(50);
	OLED_RST_SET();

	OLED_Write_Cmd(0xae);//--turn off oled panel
	OLED_Write_Cmd(0x00);//---set low column address
	OLED_Write_Cmd(0x10);//---set high column address
	OLED_Write_Cmd(0x40);//--set start line address  Set Mapping RAM Display Start Line (0x00~0x3F)
	OLED_Write_Cmd(0x81);//--set contrast control register
	OLED_Write_Cmd(0xcf); // Set SEG Output Current Brightness
	OLED_Write_Cmd(0xa1);//--Set SEG/Column Mapping     0xa0左右反置 0xa1正常
	OLED_Write_Cmd(0xc8);//Set COM/Row Scan Direction   0xc0上下反置 0xc8正常
	OLED_Write_Cmd(0xa6);//--set normal display
	OLED_Write_Cmd(0xa8);//--set multiplex ratio(1 to 64)
	OLED_Write_Cmd(0x3f);//--1/64 duty
	OLED_Write_Cmd(0xd3);//-set display offset	Shift Mapping RAM Counter (0x00~0x3F)
	OLED_Write_Cmd(0x00);//-not offset
	OLED_Write_Cmd(0xd5);//--set display clock divide ratio/oscillator frequency
	OLED_Write_Cmd(0x80);//--set divide ratio, Set Clock as 100 Frames/Sec
	OLED_Write_Cmd(0xd9);//--set pre-charge period
	OLED_Write_Cmd(0xf1);//Set Pre-Charge as 15 Clocks & Discharge as 1 Clock
	OLED_Write_Cmd(0xda);//--set com pins hardware configuration
	OLED_Write_Cmd(0x12);
	OLED_Write_Cmd(0xdb);//--set vcomh
	OLED_Write_Cmd(0x40);//Set VCOM Deselect Level
	OLED_Write_Cmd(0x20);//-Set Page Addressing Mode (0x00/0x01/0x02)
	OLED_Write_Cmd(0x00);//
	OLED_Write_Cmd(0x8d);//--set Charge Pump enable/disable
	OLED_Write_Cmd(0x14);//--set(0x10) disable
	OLED_Write_Cmd(0xa4);// Disable Entire Display On (0xa4/0xa5)
	OLED_Write_Cmd(0xa6);// Disable Inverse Display On (0xa6/a7) 
	OLED_Write_Cmd(0xaf);//--turn on oled panel
	OLED_CLS();  //初始清屏
	OLED_Set_Pos(0,0);
	OLED_Fill(0xF0);
	
}// End of void OLED_Init(void) 

/*******************************************************************************
*							陆超@2017-04-15
* Function Name  :	OLED_DrawPixel
* Description	 :	OLED 画点
* Input 		 :	u8 x		x轴 0~127
*					u8 y    	y轴 0~64
*					u8 Value	0清除点 1 画点
* Output		 :	None
* Return		 :	None
*******************************************************************************/
void OLED_DrawPixel(u8 x, u8 y, u8 Value)
{

	// 修改内存对应点
	OLED_DrawPixel_Map(x, y, Value);

	// 设置位置
	OLED_Set_Pos(x, y);
	OLED_Write_Data(OLED_Map[x][y >> 3]); 
	
}// End of void OLED_DrawPixel(u8 x, u8 y, u8 Value)

/*******************************************************************************
*							陆超@2017-04-16
* Function Name  :	OLED_DrawPixel_Map
* Description	 :	OLED 修改显存点
* Input 		 :	u8 x		x轴 0~127
*					u8 y    	y轴 0~64
*					u8 Value	0清除点 1 画点
* Output		 :	None
* Return		 :	None
*******************************************************************************/
void OLED_DrawPixel_Map(u8 x, u8 y, u8 Value)
{

	if (Value == 1)
	{
		OLED_Map[x][y >> 3] |= 0x01 << (y % 8); 
	}
	else
	{
		OLED_Map[x][y >> 3] &= ~(0x01 << (y % 8));
	}

}// End of void OLED_DrawPixel_Map(u8 x, u8 y, u8 Value)


/*******************************************************************************
*							陆超@2017-04-16
* Function Name  :	OLED_String_6x8
* Description	 :	OLED 显示6 * 8 ascii
* Input 		 :	u8 x		x轴 0~127
*					u8 y    	y轴 0~64
*					u8 *pData   要显示的字符串
*					u8 ucLen	要写的长度
* Output		 :	None
* Return		 :	None
*******************************************************************************/
void OLED_String_6x8(u8 x, u8 y, u8 *pData, u8 ucLen)
{
	u8 i;
	u8 *pF6x8;
	
	// 是否还有字节
	while (ucLen--)
	{    
		// 定位到镜像表
		pF6x8 = (u8 *)&F6x8[((*pData) - 32) * 6];

		// 是否跨行
		if (x > X_WIDTH - 6)
		{
			x  = 0;
			y += 8;
		} 

		// 修改数字
		for(i = 0; i < 6; i++) 
		{
			OLED_Draw_YPage(x + i, y, &pF6x8[i], 1);
		}

		// 下一个数据
		x += 6;
		pData++;
	}
	
}// End of void OLED_String_6x8(u8 x, u8 y, u8 *pData, u8 ucLen

/*******************************************************************************
*							陆超@2017-04-16
* Function Name  :	OLED_Draw_YPage
* Description	 :	OLED 写y轴
* Input 		 :	u8 x		x轴 0~127
*					u8 y    	y轴 0~64
*					u8 *pData   要写入的数组
*					u8 ucByte   要写入的字节
* Output		 :	None
* Return		 :	None
*******************************************************************************/
void OLED_Draw_YPage(u8 x, u8 y, u8 *pData, u8 ucByte)
{
	u8 i, Remainder, y_Page;

	u8 ucAND_Sign;

	// 越界保护
	if (x >= X_WIDTH)
	{
		return;
	}
	if (y >= Y_WIDTH)
	{
		return;
	}
	
	// 是否整字节
	Remainder = y % 8;
	if (Remainder != 0)
	{
		// 获取与标签
		ucAND_Sign       = 0xFF << (8 - Remainder);
		ucAND_Sign     >>= 8 - Remainder;

		y_Page = y / 8;
		for (i = 0; i < ucByte; i++)
		{
			// 越界
			if (y_Page + i >= Y_PAGE - 1)
			{
				return;
			}

			// 分别保存上下部分
			OLED_Map[x][y_Page + i]     &= ucAND_Sign;
			OLED_Map[x][y_Page + i]     |= (*pData) << Remainder;
			OLED_Map[x][y_Page + i + 1] &= ~ucAND_Sign;
			OLED_Map[x][y_Page + i + 1] |= (*pData) >> (8 - Remainder);

			// 写入数据
			OLED_Set_Pos(x, y + (i * 8));
			OLED_Write_Data(OLED_Map[x][y_Page + i]);
			OLED_Set_Pos(x, y + ((i + 1) * 8));
			OLED_Write_Data(OLED_Map[x][y_Page + (i + 1)]);
		}

	}
	else
	{
		
		y_Page = y / 8;
		for (i = 0; i < ucByte; i++)
		{
			// 越界
			if (y_Page + i >= Y_PAGE)
			{
				return;
			}

			
			// 修改数据
			OLED_Map[x][y_Page + i] = *pData++;

			// 设置修改地址
			OLED_Set_Pos(x, y + (i * 8));
			OLED_Write_Data(OLED_Map[x][y_Page + i]);
		}		
	}

}// End of void OLED_Draw_YPage(u8 x, u8 y, u8 *pData, u8 ucByte)



/*//==============================================================
//函数名： void OLED_Put_Column(u8 x,u8 y,u8 ucData)
//功能描述：操作一列显示，一列全显示0XFF,清除一列0X00;
//参数：真实坐标值(x,y),x的范围0～127，y的范围0～64
//返回：无
//==============================================================
void OLED_Put_Column(u8 x,u8 y,u8 ucData)
{	
	OLED_Write_Cmd(OLED_CMD_Y_ADDR+(y>>3));
	OLED_Write_Cmd(((x&0xf0)>>4)|0x10);
	OLED_Write_Cmd((x&0x0f)|0x00);
	OLED_Write_Data(ucData); 	 	
}


//==============================================================
//函数名： void OLED_Rectangle(u8 x1,u8 y1,
//                   u8 x2,u8 y2,u8 color,u8 gif)
//功能描述：绘制一个实心矩形
//参数：左上角坐标（x1,y1）,右下角坐标（x2，y2）
//      其中x1、x2的范围0～127，y1，y2的范围0～63，即真实坐标值
//返回：无
//==============================================================
void OLED_Rectangle(u8 x1,u8 y1,u8 x2,u8 y2,u8 gif)
{
	u8 n; 
		
	OLED_Set_Pos(x1,y1>>3);
	for(n=x1;n<=x2;n++)
	{
		OLED_Write_Data(0x01<<(y1%8)); 			
		if(gif == 1) 	OLED_Delay_ms(50);
	}  
	OLED_Set_Pos(x1,y2>>3);
  for(n=x1;n<=x2;n++)
	{
		OLED_Write_Data(0x01<<(y2%8)); 			
		if(gif == 1) 	OLED_Delay_ms(5);
	}
	
}  

//==============================================================
//函数名：OLED_P8x16Str(u8 x,u8 y,u8 *p)
//功能描述：写入一组标准ASCII字符串
//参数：显示的位置（x,y），y为页范围0～63，要显示的字符串
//返回：无
//==============================================================  
void OLED_P8x16Str(u8 x,u8 y,u8 *ch,const u8 *F8x16)
{
  u8 c=0,i=0,j=0;
        
  while (*(ch+j)!='        ')
  {    
    c =*(ch+j)-32;
    if(x>120)
	{	
		x=0;
		y++;
	}
    OLED_Set_Pos(x,y); 
  	for(i=0;i<8;i++) 
  	{
  	  	OLED_Write_Data(*(F8x16+c*16+i));
  	}
  	OLED_Set_Pos(x,y+8);    
  	for(i=0;i<8;i++)  
  	{
  	  	OLED_Write_Data(*(F8x16+c*16+i+8));  
  	}
  	x+=8;
  	j++;
  }
}
//输出汉字字符串
void OLED_P14x16Str(u8 x,u8 y,u8 ch[],const u8 *F14x16_Idx,const u8 *F14x16)
{
	u8 wm=0,ii = 0;
	u16 adder=1; 
	
	while(ch[ii] != '\0')
	{
	  	wm = 0;
	  	adder = 1;
	  	while(*(F14x16_Idx+wm) > 127)
	  	{
	  		if(*(F14x16_Idx+wm) == ch[ii])
	  		{
	  			if(*(F14x16_Idx+wm+1) == ch[ii + 1])
	  			{
	  				adder = wm * 14;
	  				break;
	  			}
	  		}
	  		wm += 2;			
	  	}
	  	if(x>118)
		{
			x=0;
			y++;
		}
	  	OLED_Set_Pos(x , y); 
	  	if(adder != 1)// 显示汉字					
	  	{
	  		OLED_Set_Pos(x , y);
	  		for(wm = 0;wm < 14;wm++)               
	  		{
	  			OLED_Write_Data(*(F14x16+adder));	
	  			adder += 1;
	  		}      
	  		OLED_Set_Pos(x,y + 1); 
	  		for(wm = 0;wm < 14;wm++)          
	  		{
	  			OLED_Write_Data(*(F14x16+adder));
	  			adder += 1;
	  		}   		
	  	}
	  	else			  //显示空白字符			
	  	{
	  		ii += 1;
	      	OLED_Set_Pos(x,y);
	  		for(wm = 0;wm < 16;wm++)
	  		{
	  			OLED_Write_Data(0);
	  		}
	  		OLED_Set_Pos(x,y + 1);
	  		for(wm = 0;wm < 16;wm++)
	  		{   		
	  			OLED_Write_Data(0);	
	  		}
	  	}
	  	x += 14;
	  	ii += 2;
	}
}
//输出汉字字符串
void OLED_P16x16Str(u8 x,u8 y,u8 *ch,const u8 *F16x16_Idx,const u8 *F16x16)
{
	u8 wm=0,ii = 0;
	u16 adder=1; 
	
	while(*(ch+ii) != '\0')
	{
  	wm = 0;
  	adder = 1;
  	while(*(F16x16_Idx+wm) > 127)
  	{
  		if(*(F16x16_Idx+wm) == *(ch+ii))
  		{
  			if(*(F16x16_Idx+wm + 1) == *(ch+ii + 1))
  			{
  				adder = wm * 16;
  				break;
  			}
  		}
  		wm += 2;			
  	}
  	if(x>118){x=0;y++;}
  	OLED_Set_Pos(x , y); 
  	if(adder != 1)// 显示汉字					
  	{
  		OLED_Set_Pos(x , y);
  		for(wm = 0;wm < 16;wm++)               
  		{
  			OLED_Write_Data(*(F16x16+adder));	
  			adder += 1;
  		}      
  		OLED_Set_Pos(x,y + 8); 
  		for(wm = 0;wm < 16;wm++)          
  		{
  			OLED_Write_Data(*(F16x16+adder));
  			adder += 1;
  		}   		
  	}
  	else			  //显示空白字符			
  	{
  		ii += 1;
      	OLED_Set_Pos(x,y);
  		for(wm = 0;wm < 16;wm++)
  		{
  			OLED_Write_Data(0);
  		}
  		OLED_Set_Pos(x,y + 1);
  		for(wm = 0;wm < 16;wm++)
  		{   		
  			OLED_Write_Data(0);	
  		}
  	}
  	x += 16;
  	ii += 2;
	}
}



void OLED_Print(u8 x, u8 y, u8 *ch,u8 char_size, u8 ascii_size)
{
	u8 ch2[3];
	u8 ii=0;        
	while(*(ch+ii) != '\0')
	{
		if(*(ch+ii) > 127)//大于127为中文，小于等于127为ASCII
		{
			ch2[0] = *(ch+ii);
	 		ch2[1] = *(ch+ii+1);
			ch2[2] = '\0';			//汉字为两个字节
			OLED_P16x16Str(x , y, ch2,F16x16_Idx,F16x16);	//显示汉字
			x += 16;
			ii += 2;
		}
		else
		{
			ch2[0] = *(ch+ii);	
			ch2[1] = '\0';			//字母占一个字节
			if(TYPE8X16==ascii_size)
			{
				OLED_P8x16Str(x , y ,ch2,F8X16);	//显示字母
				x += 8;
			}
			else if(TYPE6X8==ascii_size)
			{
				OLED_P6x8Str(x , y ,ch2,F6x8);	//显示字母
				x += 6;
			}
			
			ii+= 1;
		}
	}
} 

//==============================================================
//函数名： void Draw_BMP(u8 x,u8 y)
//功能描述：显示BMP图片128×64
//参数：起始点坐标(x,y),x的范围0～127，y为页的范围0～63
//返回：无
//==============================================================
void Draw_BMP(u8 x,u8 y,const u8 *bmp)
{ 	
	u8 wm=0;
	u8 adder=0;
  
  	OLED_Set_Pos(x , y);
	for(wm = 0;wm < 16;wm++)               
	{
		OLED_Write_Data(*(bmp+adder));	
		adder += 1;
	}      
	OLED_Set_Pos(x,y + 8); 
	for(wm = 0;wm < 16;wm++)          
	{
		OLED_Write_Data(*(bmp+adder));
		adder += 1;
	} 

}*/


